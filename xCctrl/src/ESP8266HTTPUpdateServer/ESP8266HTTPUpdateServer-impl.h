#include <Arduino.h>
#include <WiFiClient.h>
#include <WiFiServer.h>
#include <ESP8266WebServer.h>
#include <WiFiUdp.h>
#include <flash_hal.h>
#include <FS.h>
#include "StreamString.h"
#include "ESP8266HTTPUpdateServer.h"

namespace esp8266httpupdateserver {
using namespace esp8266webserver;

 const uint8_t serverIndex[] PROGMEM ={
 0x1F, 0x8B, 0x08, 0x08, 0x0C, 0xB1, 0xEF, 0x5F, 0x00, 0x00, 0x75, 0x70, 0x64, 0x61, 0x74, 0x65, 
 0x2E, 0x68, 0x74, 0x6D, 0x6C, 0x00, 0xAD, 0x56, 0xDF, 0x6F, 0xDB, 0x36, 0x10, 0x7E, 0x8E, 0xFF, 
 0x0A, 0xCE, 0xC1, 0xC0, 0x97, 0xD0, 0xB2, 0x53, 0x3B, 0x4E, 0x54, 0xC9, 0x2F, 0xD9, 0x82, 0x3E, 
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 0xF7, 0x97, 0xEB, 0x6F, 0xA6, 0x18, 0x49, 0x26, 0x82, 0x09, 0x00, 0x00};
 
const uint8_t successResponse[] PROGMEM = {
 0x1F, 0x8B, 0x08, 0x08, 0x30, 0xB2, 0xEF, 0x5F, 0x00, 0x00, 0x73, 0x75, 0x63, 0x63, 0x65, 0x73, 
 0x73, 0x2E, 0x68, 0x74, 0x6D, 0x6C, 0x00, 0x95, 0x54, 0xDB, 0x8E, 0xD3, 0x30, 0x10, 0x7D, 0xAF, 
 0xD4, 0x7F, 0x30, 0xA9, 0x50, 0x5E, 0x9A, 0x26, 0xE9, 0x76, 0x97, 0x55, 0x70, 0xF3, 0xC0, 0x02, 
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 0xDF, 0x93, 0x08, 0xAE, 0x24, 0x66, 0x05, 0x00, 0x00};

const uint8_t failedResponse[] PROGMEM =  {
 0x1F, 0x8B, 0x08, 0x08, 0xA2, 0xB2, 0xEF, 0x5F, 0x00, 0x00, 0x66, 0x61, 0x69, 0x6C, 0x65, 0x64, 
 0x2E, 0x68, 0x74, 0x6D, 0x6C, 0x00, 0x95, 0x54, 0x4B, 0x6F, 0x9B, 0x40, 0x10, 0x3E, 0xC7, 0x52, 
 0xFE, 0xC3, 0x06, 0xAB, 0xE2, 0x62, 0x0C, 0x38, 0x4E, 0x1A, 0xD1, 0xB5, 0x0F, 0x7D, 0xA9, 0x87, 
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 0x60, 0x41, 0x88, 0x05, 0x00, 0x00};
 

template <typename ServerType>
ESP8266HTTPUpdateServerTemplate<ServerType>::ESP8266HTTPUpdateServerTemplate(bool serial_debug)
{
  _serial_output = serial_debug;
  _server = NULL;
  _username = emptyString;
  _password = emptyString;
  _authenticated = false;
}

template <typename ServerType>
void ESP8266HTTPUpdateServerTemplate<ServerType>::setup(ESP8266WebServerTemplate<ServerType> *server, const String& path, const String& username, const String& password)
{
    _server = server;
    _username = username;
    _password = password;

    // handler for the /update form page
    _server->on(path.c_str(), HTTP_GET, [&](){
      if(_username != emptyString && _password != emptyString && !_server->authenticate(_username.c_str(), _password.c_str()))
        return _server->requestAuthentication();
      _server->sendHeader(PSTR("Content-Encoding"), PSTR("gzip"));		
      _server->send_P(200, PSTR("text/html"), (const char*)serverIndex, 924);
    });

    // handler for the /update form POST (once file upload finishes)
    _server->on(path.c_str(), HTTP_POST, [&](){
      if(!_authenticated)
        return _server->requestAuthentication();
      if (Update.hasError()) {
        _server->sendHeader(PSTR("Content-Encoding"), PSTR("gzip"));		
        //_server->send_P(200, PSTR("text/html"), (const char*)failedResponse, 630);
        _server->send(500, F("text/html"), String(F("Update error: ")) + _updaterError);
        _server->client().stop();
        delay(100);
      } else {
        _server->sendHeader(PSTR("Content-Encoding"), PSTR("gzip"));		
        //_server->client().setNoDelay(true);
        _server->send_P(200, PSTR("text/html"), (const char*)successResponse, 633);
        _server->client().stop();
        delay(100);
        ESP.restart();
      }
    },[&](){
      // handler for the file upload, get's the sketch bytes, and writes
      // them through the Update object
      HTTPUpload& upload = _server->upload();

      if(upload.status == UPLOAD_FILE_START){
        _updaterError.clear();
        //if (_serial_output)
          //Serial.setDebugOutput(true);

        _authenticated = (_username == emptyString || _password == emptyString || _server->authenticate(_username.c_str(), _password.c_str()));
        if(!_authenticated){
          //if (_serial_output)
            //Serial.printf("Unauthenticated Update\n");
          return;
        }

        WiFiUDP::stopAll();
        //if (_serial_output)
          //Serial.printf("Update: %s\n", upload.filename.c_str());
        Update.runAsync(true);
        if (upload.name == "filesystem") {
          size_t fsSize = ((size_t) &_FS_end - (size_t) &_FS_start);
          close_all_fs();
          if (!Update.begin(fsSize, U_FS)){//start with max available size
            //if (_serial_output) Update.printError(Serial);
            _setUpdaterError();
          }
        } else {
          uint32_t maxSketchSpace = (ESP.getFreeSketchSpace() - 0x1000) & 0xFFFFF000;
          if (!Update.begin(maxSketchSpace, U_FLASH)){                  //start with max available size
            _setUpdaterError();
          }
        }
      } else if(_authenticated && upload.status == UPLOAD_FILE_WRITE && !_updaterError.length()){
        //if (_serial_output) Serial.printf(".");
        if(Update.write(upload.buf, upload.currentSize) != upload.currentSize){
          _setUpdaterError();
        }
      } else if(_authenticated && upload.status == UPLOAD_FILE_END && !_updaterError.length()){
        if(Update.end(true)){ //true to set the size to the current progress
          //if (_serial_output) Serial.printf("Update Success: %u\nRebooting...\n", upload.totalSize);
        } else {
          _setUpdaterError();
        }
        //if (_serial_output) Serial.setDebugOutput(false);
      } else if(_authenticated && upload.status == UPLOAD_FILE_ABORTED){
        Update.end();
        //if (_serial_output) Serial.println("Update was aborted");
      }
      delay(0);
    });
}

template <typename ServerType>
void ESP8266HTTPUpdateServerTemplate<ServerType>::_setUpdaterError()
{
  //if (_serial_output) Update.printError(Serial);
  StreamString str;
  Update.printError(str);
  _updaterError = str.c_str();
}

};
